## yocto/meta-oneo/conf/layer.conf
```bitbake
# meta-oneo layer configuration (Yocto 5.0 Scarthgap)
BBPATH .= ":${LAYERDIR}"
BBFILES += "${LAYERDIR}/recipes-*/*/*.bb ${LAYERDIR}/recipes-*/*/*.bbappend"

BBFILE_COLLECTIONS += "oneo"
BBFILE_PATTERN_oneo = "^${LAYERDIR}/"
BBFILE_PRIORITY_oneo = "9"

LAYERVERSION_oneo = "1"
LAYERSERIES_COMPAT_oneo = "scarthgap"

# Layers required by meta-oneo
LAYERDEPENDS_oneo = "core freescale-layer freescale-distro openembedded-layer networking-layer multimedia-layer qt6-layer rauc"
```
